## conf/machine/amd-zynqmp-basic.inc
```bitbake
DEFAULTTUNE = "cortexa53"

require conf/machine/include/arm/armv8a/tune-cortexa53.inc

MACHINE_FEATURES += "ext3 pci usbgadget usbhost vfat keyboard network"
```

## conf/machine/amd-zynqmp-sdt.inc
```bitbake
WORKFLOW_MACHINE_NAME ??= ""

MACHINE_CONF = "${@'${WORKFLOW_MACHINE_NAME}.conf' if d.getVar("WORKFLOW_MACHINE_NAME") != "" else 'zynqmp-zcu102-sdt-full.conf'}"

require conf/machine/${MACHINE_CONF}
```

## conf/machine/amd-zynqmp.conf
```bitbake
#@TYPE: Machine
#@NAME: amd-zynqmp
#@DESCRIPTION: Machine configuration for Zynq Ultrascale+ MPSoC

DEFAULTTUNE = "cortexa53"
require conf/machine/include/arm/armv8a/tune-cortexa53.inc

BSP_XILINX_DERIVED:append = " amd-zynqmp"
MACHINE_FEATURES += "ext3 pci usbgadget usbhost vfat keyboard network"
EXTRA_IMAGECMD:jffs2 = "--pad --no-cleanmarkers --eraseblock=128"

KERNEL_IMAGETYPE = "Image"
KERNEL_DEVICETREE:amd-zynqmp = "xilinx/zynqmp-zcu102-rev1.0.dtb xilinx/zynqmp-zcu102-rev1.0-canfd.dtb"

SERIAL_CONSOLE = "115200 ttyPS0"

# variables needed by xilinx-bootbin
PREFERRED_PROVIDER_virtual/boot-bin ??= "xilinx-bootbin"
SOC_FAMILY ?= "zynqmp"

PREFERRED_PROVIDER_virtual/kernel ??= "linux-yocto"
PREFERRED_VERSION_linux-yocto ?= "6.6%"

MACHINE_EXTRA_RRECOMMENDS = " kernel-modules kernel-devicetree"
IMAGE_FSTYPES += "tar.bz2 wic wic.bmap"

# wic support
WKS_FILE ?= "zynqmp-sdimage.wks"
do_image_wic[depends] += "mtools-native:do_populate_sysroot dosfstools-native:do_populate_sysroot"
IMAGE_BOOT_FILES ?= " Image zynqmp-zcu102-rev1.0.dtb"

# U-boot
UBOOT_ELF="u-boot.elf"
UBOOT_ELF_SUFFIX ?= "elf"
UBOOT_MACHINE = "xilinx_zynqmp_virt_defconfig"

# multilib support
MULTILIBS ?= "multilib:lib32"
DEFAULTTUNE:virtclass-multilib-lib32 ?= "armv7athf-neon"

XSERVER:append = " xf86-video-armsoc"
```

## conf/machine/zynqmp-ostree.inc
```bitbake
OSTREE_BOOTLOADER_INCLUDE ?= ""
OSTREE_SD_UBOOT_WIC1 ?= ""
OSTREE_SD_BOOT_ALIGN ?= "4096"
OSTREE_FDISK_BLM ?= "8192"
OSTREE_FDISK_FSZ ?= "132"
OSTREE_KERNEL ?= "Image"
OSTREE_UBOOT_CMD ?= "booti"
OSTREE_WKS_EFI_SIZE ?= "--size=64M"
INSTAB ?= "1"
DEFAULT_DTB ?= "zynqmp-zcu102-rev1.0.dtb"
OSTREE_NETINST_DEV ?= "/dev/mmcblk0,/dev/sda,/dev/vda"
OSTREE_NETINST_ARGS ?= "${OSTREE_CONSOLE} bl=ufsd rdinit=/install instdev=${OSTREE_NETINST_DEV} instname=wrlinux instbr=\$BRANCH insturl=\$URL instab=${OSTREE_USE_AB} instsf=1 instdate=BUILD_DATE"
OSTREE_COPY_IMAGE_BOOT_FILES = "1"
INITRAMFS_IMAGE ??= ""
IMAGE_BOOT_FILES:append = " ${@bb.utils.contains('DISTRO_FEATURES', 'ostree', 'boot.scr', '', d)} ${@bb.utils.contains('DISTRO_FEATURES', 'ostree', '${INITRAMFS_IMAGE}-${MACHINE}.${INITRAMFS_FSTYPES};initramfs', '', d)}"
MACHINEOVERRIDES:prepend:amd-zynqmp = "mali400:zynqmp:zynqmp-eg:"

OSTREE_BOOTSCR_PRECMD ?= "\
setenv no_menu yes; \
"
```
